/*
 * ssd1306 — SSD1306 OLED driver via shared I2C bus.
 *
 * Wire protocol: each I2C transaction is [control byte][data bytes].
 *   control 0x00 = next bytes are commands
 *   control 0x40 = next bytes are display RAM data
 *
 * The init sequence below matches Adafruit's reference. After init,
 * GDDRAM is page-addressed (auto-increment column within page, then
 * wrap to next page). ssd1306_set_pos() resets the cursor.
 */

#include "ssd1306.h"

#include <stdarg.h>
#include <stdio.h>
#include <string.h>

#include "esp_log.h"

#include "i2c_bus.h"

static const char *TAG = "ssd1306";

#define ADDR  0x3C
#define CTRL_CMD   0x00
#define CTRL_DATA  0x40

// 6x8 monospace font — ASCII 0x20..0x7F (96 glyphs × 5 bytes + 1 pad column)
// Generated from public-domain font; column-major bits, LSB at top.
static const uint8_t FONT[96][5] = {
    {0x00,0x00,0x00,0x00,0x00}, // ' '
    {0x00,0x00,0x5F,0x00,0x00}, // '!'
    {0x00,0x07,0x00,0x07,0x00}, // '"'
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    {0x00,0x00,0x00,0x00,0x00}, // 0x7F
};

static bool s_inited = false;

static bool cmd(uint8_t c)
{
    return i2c_bus_write_reg(ADDR, CTRL_CMD, c) == ESP_OK;
}

bool ssd1306_init(void)
{
    if (s_inited) return true;
    i2c_bus_init();

    if (!i2c_bus_probe(ADDR)) {
        ESP_LOGE(TAG, "OLED not found at 0x%02X", ADDR);
        return false;
    }

    static const uint8_t init_seq[] = {
        0xAE,        // display OFF
        0xD5, 0x80,  // clock div
        0xA8, 0x3F,  // multiplex 64
        0xD3, 0x00,  // offset 0
        0x40,        // start line 0
        0x8D, 0x14,  // charge pump on
        0x20, 0x00,  // horizontal addressing
        0xA1,        // segment remap
        0xC8,        // COM scan dec
        0xDA, 0x12,  // COM pins config
        0x81, 0x7F,  // contrast
        0xD9, 0xF1,  // pre-charge
        0xDB, 0x40,  // VCOM detect
        0xA4,        // resume RAM
        0xA6,        // normal display
        0xAF,        // display ON
    };
    for (size_t i = 0; i < sizeof(init_seq); ++i) {
        if (!cmd(init_seq[i])) {
            ESP_LOGE(TAG, "init cmd %u failed", (unsigned)i);
            return false;
        }
    }
    ssd1306_clear();
    s_inited = true;
    ESP_LOGI(TAG, "init OK — 128×64 @ 0x%02X", ADDR);
    return true;
}

void ssd1306_set_pos(uint8_t col, uint8_t page)
{
    if (col > 127) col = 0;
    if (page > 7)  page = 0;
    cmd(0x21);          // set column address
    cmd(col);
    cmd(127);
    cmd(0x22);          // set page address
    cmd(page);
    cmd(7);
}

void ssd1306_clear(void)
{
    ssd1306_set_pos(0, 0);
    // 128 × 8 = 1024 bytes of 0x00 sent as data
    uint8_t buf[17] = { CTRL_DATA };
    for (int i = 0; i < SSD1306_PAGES * SSD1306_W / 16; ++i) {
        i2c_bus_write(ADDR, buf, sizeof(buf));
    }
    ssd1306_set_pos(0, 0);
}

void ssd1306_write_text(const char *s)
{
    while (*s) {
        unsigned char c = (unsigned char)*s++;
        if (c < 0x20 || c >= 0x80) c = 0x20;     // unsupported → space
        const uint8_t *glyph = FONT[c - 0x20];
        uint8_t buf[7] = { CTRL_DATA,
                           glyph[0], glyph[1], glyph[2], glyph[3], glyph[4], 0x00 };
        i2c_bus_write(ADDR, buf, sizeof(buf));
    }
}

void ssd1306_printf_line(uint8_t page, const char *fmt, ...)
{
    char line[32];      // page is 128px / 6px-per-glyph = 21 chars
    va_list ap;
    va_start(ap, fmt);
    int n = vsnprintf(line, sizeof(line), fmt, ap);
    va_end(ap);
    if (n < 0) return;
    if (n > 21) n = 21;
    line[n] = '\0';

    ssd1306_set_pos(0, page);
    ssd1306_write_text(line);
    // Pad the rest of the line with spaces to clear old content
    int written = n * 6;
    char pad[2] = { ' ', '\0' };
    while (written + 6 <= 128) {
        ssd1306_write_text(pad);
        written += 6;
    }
}
